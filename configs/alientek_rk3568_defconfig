## configs/alientek_rk3568_defconfig
```kconfig
#include "base/base.config"
#include "bus/can.config"
#include "bus/pci.config"
#include "chips/rk3566_rk3568_aarch64.config"
#include "font/chinese.config"
#include "fs/exfat.config"
#include "fs/ntfs.config"
#include "fs/vfat.config"
#include "gpu/mali.config"
#include "multimedia/audio.config"
#include "multimedia/camera.config"
#include "multimedia/gst/audio.config"
#include "multimedia/gst/camera.config"
#include "multimedia/gst/rtsp.config"
#include "multimedia/gst/video.config"
#include "multimedia/mpp.config"
#include "wifibt/bt.config"
#include "wifibt/wireless.config"
#include "tools/benchmark.config"
#include "tools/common.config"
#include "tools/test.config"
# #include "network/chromium.config"
#include "ai/npu2.config"
# #include "gui/weston.config"
# #include "gui/lvgl.config"
# #include "gui/qt5.config"
BR2_GENERATE_LOCALE="en_US"
BR2_LV_DRIVERS_USE_RGA=y
BR2_LV_FS_STDIO_LETTER=47
BR2_LV_FS_STDIO_PATH="/"
BR2_LV_IME_PINYIN_USE_K9_MODE=y
BR2_LV_USE_FRAGMENT=y
BR2_LV_USE_GRIDNAV=y
BR2_LV_USE_IME_PINYIN=y
BR2_LV_USE_IMGFONT=y
BR2_LV_USE_MONKEY=y
BR2_PACKAGE_CONNMAN=y
BR2_PACKAGE_CONNMAN_CLIENT=y
BR2_PACKAGE_CONNMAN_LOOPBACK=y
BR2_PACKAGE_CONNMAN_WIFI=y
BR2_PACKAGE_COREUTILS_INDIVIDUAL_BINARIES=y
# BR2_PACKAGE_DHCPCD is reset to default
BR2_PACKAGE_DNSMASQ_CONNTRACK=y
BR2_PACKAGE_DNSMASQ_DNSSEC=y
BR2_PACKAGE_DNSMASQ_IDN=y
# BR2_PACKAGE_DROPBEAR is reset to default
BR2_PACKAGE_ESPEAK=y
BR2_PACKAGE_ESPEAK_AUDIO_BACKEND_PULSEAUDIO=y
BR2_PACKAGE_ETHTOOL=y
BR2_PACKAGE_FFMPEG_FFPLAY=y
BR2_PACKAGE_FFMPEG_FFPROBE=y
BR2_PACKAGE_FFMPEG_GPL=y
BR2_PACKAGE_FFMPEG_NONFREE=y
BR2_PACKAGE_FILE=y
BR2_PACKAGE_GDB=y
BR2_PACKAGE_GDB_DEBUGGER=y
BR2_PACKAGE_GDB_SERVER=y
BR2_PACKAGE_GDB_TUI=y
BR2_PACKAGE_GLIBC_UTILS=y
BR2_PACKAGE_GNUTLS_OPENSSL=y
BR2_PACKAGE_GST1_PLUGINS_BAD_PLUGIN_BLUEZ=y
BR2_PACKAGE_GST1_PLUGINS_BAD_PLUGIN_FBDEV=y
BR2_PACKAGE_GST1_PLUGINS_BASE_LIB_OPENGL=y
BR2_PACKAGE_GST1_PLUGINS_UGLY_PLUGIN_X264=y
BR2_PACKAGE_GST1_RTSP_SERVER=y
BR2_PACKAGE_HOST_GDB=y
BR2_PACKAGE_HOST_GDB_PYTHON3=y
BR2_PACKAGE_HOST_GDB_SIM=y
BR2_PACKAGE_HOST_GDB_TUI=y
BR2_PACKAGE_IPERF3=y
BR2_PACKAGE_KEXEC=y
BR2_PACKAGE_LIBCURL=y
BR2_PACKAGE_LIBCURL_CURL=y
BR2_PACKAGE_LIBMODBUS=y
BR2_PACKAGE_LIBOPUSENC=y
BR2_PACKAGE_LIVE555=y
BR2_PACKAGE_MEDIAMTX=y
BR2_PACKAGE_MINICOM=y
BR2_PACKAGE_MMC_UTILS=y
BR2_PACKAGE_NETSTAT_NAT=y
BR2_PACKAGE_NFS_UTILS=y
BR2_PACKAGE_NGINX=y
BR2_PACKAGE_NGINX_RTMP=y
BR2_PACKAGE_NOTO_SANS_SC=y
BR2_PACKAGE_NTP=y
BR2_PACKAGE_NTP_NTPDATE=y
BR2_PACKAGE_OPENSSH=y
BR2_PACKAGE_PPPD=y
BR2_PACKAGE_PPPD_FILTER=y
BR2_PACKAGE_PYTHON3=y
BR2_PACKAGE_PYTHON3_BZIP2=y
BR2_PACKAGE_PYTHON3_CODECSCJK=y
BR2_PACKAGE_PYTHON3_CURSES=y
BR2_PACKAGE_PYTHON3_DECIMAL=y
BR2_PACKAGE_PYTHON3_OSSAUDIODEV=y
BR2_PACKAGE_PYTHON3_READLINE=y
BR2_PACKAGE_PYTHON3_SQLITE=y
BR2_PACKAGE_PYTHON3_XZ=y
BR2_PACKAGE_PYTHON_PIP=y
BR2_PACKAGE_PYTHON_PROTOBUF=y
BR2_PACKAGE_PYTHON_PSUTIL=y
BR2_PACKAGE_PYTHON_RUAMEL_YAML=y
BR2_PACKAGE_QUECTEL_QCONNECTMANAGER=y
BR2_PACKAGE_RSYNC=y
BR2_PACKAGE_SAMBA4=y
BR2_PACKAGE_SPEECHD=y
BR2_PACKAGE_SPI_TOOLS=y
BR2_PACKAGE_VALGRIND=y
BR2_PACKAGE_VSFTPD=y
# BR2_PACKAGE_WPA_SUPPLICANT_AUTOSCAN is reset to default
BR2_PACKAGE_X265=y
BR2_ROOTFS_OVERLAY+="board/alientek/atk-dlrk3568/fs-overlay/"
BR2_SYSTEM_ENABLE_NLS=y
BR2_TARGET_GENERIC_ROOT_PASSWD="root"
BR2_TARGET_LOCALTIME="Asia/Shanghai"
BR2_PACKAGE_LIBBPF=y
BR2_PACKAGE_BPFTOOL=y
BR2_ROOTFS_POST_BUILD_SCRIPT="board/alientek/atk-dlrk3568/post-build.sh"
```

## package/mediamtx/Config.in
```kconfig
config BR2_PACKAGE_MEDIAMTX
	bool "MediaMTX"
	depends on BR2_USE_MMU
	depends on !BR2_STATIC_LIBS
	select BR2_PACKAGE_HOST_GO
	help
	  MediaMTX is a ready-to-use RTSP / RTMP / HLS / WebRTC media
	  server and media proxy that allows to read, publish and proxy
	  video and audio streams.

	  https://github.com/bluenviron/mediamtx
```

## package/quectel_qconnectmanager/Config.in
```kconfig
config BR2_PACKAGE_QUECTEL_QCONNECTMANAGER
	bool "Connect Manager program provided by Quectel"
	default n
	help
	  Used to test GobiNet/QMI_WWAN driver
```
